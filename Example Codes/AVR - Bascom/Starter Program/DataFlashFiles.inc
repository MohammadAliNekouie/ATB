Const Flash_boats_bin = 0
Const Flash_boats_bin_size = 153600
Const Flash_boats_bin_width = 240
Const Flash_boats_bin_height = 320

Const Flash_coast_bin = 153600
Const Flash_coast_bin_size = 153600
Const Flash_coast_bin_width = 240
Const Flash_coast_bin_height = 320

Const Flash_colors_bin = 307200
Const Flash_colors_bin_size = 153600
Const Flash_colors_bin_width = 240
Const Flash_colors_bin_height = 320

Const Flash_desert_bin = 460800
Const Flash_desert_bin_size = 153600
Const Flash_desert_bin_width = 240
Const Flash_desert_bin_height = 320

Const Flash_eiffeltower_bin = 614400
Const Flash_eiffeltower_bin_size = 153600
Const Flash_eiffeltower_bin_width = 240
Const Flash_eiffeltower_bin_height = 320

Const Flash_orange_bin = 768000
Const Flash_orange_bin_size = 153600
Const Flash_orange_bin_width = 240
Const Flash_orange_bin_height = 320

Const Flash_pcb_bin = 921600
Const Flash_pcb_bin_size = 153600
Const Flash_pcb_bin_width = 240
Const Flash_pcb_bin_height = 320

Const Flash_spices_bin = 1075200
Const Flash_spices_bin_size = 153600
Const Flash_spices_bin_width = 240
Const Flash_spices_bin_height = 320

Const Flash_frame_000_bin = 1228800
Const Flash_frame_000_bin_size = 34240
Const Flash_frame_000_bin_width = 107
Const Flash_frame_000_bin_height = 160

Const Flash_frame_001_bin = 1263040
Const Flash_frame_001_bin_size = 34240
Const Flash_frame_001_bin_width = 107
Const Flash_frame_001_bin_height = 160

Const Flash_frame_002_bin = 1297280
Const Flash_frame_002_bin_size = 34240
Const Flash_frame_002_bin_width = 107
Const Flash_frame_002_bin_height = 160

Const Flash_frame_003_bin = 1331520
Const Flash_frame_003_bin_size = 34240
Const Flash_frame_003_bin_width = 107
Const Flash_frame_003_bin_height = 160

Const Flash_frame_004_bin = 1365760
Const Flash_frame_004_bin_size = 34240
Const Flash_frame_004_bin_width = 107
Const Flash_frame_004_bin_height = 160

Const Flash_frame_005_bin = 1400000
Const Flash_frame_005_bin_size = 34240
Const Flash_frame_005_bin_width = 107
Const Flash_frame_005_bin_height = 160

Const Flash_frame_006_bin = 1434240
Const Flash_frame_006_bin_size = 34240
Const Flash_frame_006_bin_width = 107
Const Flash_frame_006_bin_height = 160

Const Flash_frame_007_bin = 1468480
Const Flash_frame_007_bin_size = 34240
Const Flash_frame_007_bin_width = 107
Const Flash_frame_007_bin_height = 160

Const Flash_frame_008_bin = 1502720
Const Flash_frame_008_bin_size = 34240
Const Flash_frame_008_bin_width = 107
Const Flash_frame_008_bin_height = 160

Const Flash_frame_009_bin = 1536960
Const Flash_frame_009_bin_size = 34240
Const Flash_frame_009_bin_width = 107
Const Flash_frame_009_bin_height = 160

Const Flash_frame_010_bin = 1571200
Const Flash_frame_010_bin_size = 34240
Const Flash_frame_010_bin_width = 107
Const Flash_frame_010_bin_height = 160

Const Flash_frame_011_bin = 1605440
Const Flash_frame_011_bin_size = 34240
Const Flash_frame_011_bin_width = 107
Const Flash_frame_011_bin_height = 160

Const Flash_frame_012_bin = 1639680
Const Flash_frame_012_bin_size = 34240
Const Flash_frame_012_bin_width = 107
Const Flash_frame_012_bin_height = 160

Const Flash_frame_013_bin = 1673920
Const Flash_frame_013_bin_size = 34240
Const Flash_frame_013_bin_width = 107
Const Flash_frame_013_bin_height = 160

Const Flash_frame_014_bin = 1708160
Const Flash_frame_014_bin_size = 34240
Const Flash_frame_014_bin_width = 107
Const Flash_frame_014_bin_height = 160

Const Flash_frame_015_bin = 1742400
Const Flash_frame_015_bin_size = 34240
Const Flash_frame_015_bin_width = 107
Const Flash_frame_015_bin_height = 160

Const Flash_frame_016_bin = 1776640
Const Flash_frame_016_bin_size = 34240
Const Flash_frame_016_bin_width = 107
Const Flash_frame_016_bin_height = 160

Const Flash_frame_017_bin = 1810880
Const Flash_frame_017_bin_size = 34240
Const Flash_frame_017_bin_width = 107
Const Flash_frame_017_bin_height = 160

Const Flash_frame_018_bin = 1845120
Const Flash_frame_018_bin_size = 34240
Const Flash_frame_018_bin_width = 107
Const Flash_frame_018_bin_height = 160

Const Flash_frame_019_bin = 1879360
Const Flash_frame_019_bin_size = 34240
Const Flash_frame_019_bin_width = 107
Const Flash_frame_019_bin_height = 160

Const Flash_frame_020_bin = 1913600
Const Flash_frame_020_bin_size = 34240
Const Flash_frame_020_bin_width = 107
Const Flash_frame_020_bin_height = 160

Const Flash_frame_021_bin = 1947840
Const Flash_frame_021_bin_size = 34240
Const Flash_frame_021_bin_width = 107
Const Flash_frame_021_bin_height = 160

Const Flash_frame_022_bin = 1982080
Const Flash_frame_022_bin_size = 34240
Const Flash_frame_022_bin_width = 107
Const Flash_frame_022_bin_height = 160

Const Flash_frame_023_bin = 2016320
Const Flash_frame_023_bin_size = 34240
Const Flash_frame_023_bin_width = 107
Const Flash_frame_023_bin_height = 160

Const Flash_frame_024_bin = 2050560
Const Flash_frame_024_bin_size = 34240
Const Flash_frame_024_bin_width = 107
Const Flash_frame_024_bin_height = 160

Const Flash_totalsize = 2084800
