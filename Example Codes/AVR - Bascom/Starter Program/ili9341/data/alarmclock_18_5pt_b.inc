alarmclock_18_5pt_b:                                                             ' alarm clock, 18,5pt, Bold
Data 18                                                                          ' Font height in pixels
Data 48                                                                          ' Spacing: 1px
Data 13                                                                          ' Chars: 13
' Charset:  +1349ILTchou
Data 32, 43, 49, 51, 52, 57, 73, 76, 84, 99, 104, 111, 117
Data 9, 3                                                                        '   9px
Data &H00, &H00, &H19
Data 9, 23                                                                       ' + 9px
Data &H00, &H00, &H02, &H3F, &H3F, &H00, &H3E, &H00, &H00, &H00, &H40, &HC0
Data &HC1, &HFF, &HFF, &H00, &HFC, &HC0, &HC0, &H01, &H00, &H00, &H07
Data 5, 17                                                                       ' 1 5px
Data &H00, &H07, &H3F, &H7F, &H70, &H0F, &HBF, &HBF, &H00, &H20, &H00, &H80
Data &H80, &H01, &H00, &H00, &H00
Data 13, 31                                                                      ' 3 13px
Data &H00, &H00, &H00, &H40, &HC0, &HC0, &H04, &HC7, &HFF, &HFF, &H00, &H70
Data &H00, &H40, &HC0, &HC0, &H04, &HCF, &HFF, &HFF, &H00, &H20, &H00, &H40
Data &HC0, &HC0, &H07, &H80, &H00, &H00, &H00
Data 13, 30                                                                      ' 4 13px
Data &H03, &H7F, &H7F, &H00, &H38, &H00, &H00, &H03, &H07, &H3F, &H7F, &H70
Data &H00, &HC0, &HC0, &H05, &HCF, &HFF, &HFF, &H00, &H20, &H00, &H00, &H07
Data &H80, &H80, &H01, &H00, &H00, &H00
Data 13, 31                                                                      ' 9 13px
Data &H03, &H7F, &H7F, &H00, &HF8, &HC0, &HC0, &H03, &HC7, &HFF, &HFF, &H00
Data &H70, &H00, &HC0, &HC0, &H05, &HCF, &HFF, &HFF, &H00, &H20, &H00, &H40
Data &HC0, &HC0, &H07, &H80, &H00, &H00, &H00
Data 12, 33                                                                      ' I 12px
Data &H00, &H00, &H00, &H40, &HC0, &HC0, &H00, &HFF, &HFF, &H00, &HFE, &HC0
Data &HC0, &H02, &H00, &H00, &H01, &H01, &H3F, &H3F, &H00, &H3C, &H00, &H00
Data &H03, &H40, &HC0, &HC0, &H06, &H40, &H00, &H00, &H00
Data 11, 21                                                                      ' L 11px
Data &H00, &H03, &H7F, &H7F, &H00, &H38, &H00, &H00, &H04, &H07, &H3F, &HBF
Data &HB0, &H00, &H00, &H05, &H80, &HC0, &HC0, &H07, &H40
Data 10, 20                                                                      ' T 10px
Data &H40, &HC0, &HC0, &H00, &HFF, &HFF, &H00, &HFE, &HC0, &HC0, &H02, &H00
Data &H01, &H3F, &H3F, &H00, &H3C, &H00, &H00, &H0D
Data 11, 15                                                                      ' c 11px
Data &H00, &H00, &H09, &H07, &H3F, &H7F, &HF0, &HC0, &HC0, &H05, &H80, &HC0
Data &HC0, &H07, &H40
Data 13, 30                                                                      ' h 13px
Data &H00, &H03, &H7F, &H7F, &H00, &H38, &H00, &H00, &H06, &H07, &H3F, &HFF
Data &HF0, &HC0, &HC0, &H03, &HCF, &HFF, &H7F, &H20, &H80, &H80, &H00, &H00
Data &H00, &H05, &H80, &H80, &H01, &H00
Data 13, 20                                                                      ' o 13px
Data &H00, &H00, &H0B, &H07, &H3F, &H7F, &HF0, &HC0, &HC0, &H03, &HCF, &HFF
Data &H7F, &H20, &H80, &HC0, &HC0, &H08, &H80, &H00
Data 13, 22                                                                      ' u 13px
Data &H00, &H00, &H0B, &H07, &H3F, &H3F, &H00, &H30, &H00, &H00, &H03, &H0F
Data &H3F, &H3F, &H00, &H20, &H80, &HC0, &HC0, &H08, &H80, &H00
' Program space used: 338 Bytes (RLE: -139 Bytes)