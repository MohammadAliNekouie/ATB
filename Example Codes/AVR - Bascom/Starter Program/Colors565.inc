' 16-Bit (5-6-5) / 24-Bit (8-8-8) color functions and predefined colors 1.0, Apr. 2014
' http://mat.midlight.eu/wiki/index.php?title=Color-565_Library

$nocompile

Function Color24to16(byval R As Byte , Byval G As Byte , Byval B As Byte) As Word
   Local Color_tmp1 As Word , Color_tmp2 As Word
   Color_tmp1 = R * 249
   Color_tmp1 = Color_tmp1 + 1014
   Color_tmp1 = Color_tmp1 And &HF800
   Color_tmp2 = G * 253
   Color_tmp2 = Color_tmp2 + 505
   Shift Color_tmp2 , Right , 5
   Color_tmp2 = Color_tmp2 And &H07E0
   Color_tmp1 = Color_tmp1 Or Color_tmp2
   Color_tmp2 = B * 249
   Color_tmp2 = Color_tmp2 + 1014
   Shift Color_tmp2 , Right , 11
   Color_tmp1 = Color_tmp1 Or Color_tmp2
   Color24to16 = Color_tmp1
End Function

Sub Color16to24(byval Color As Word , Byref R As Byte , Byref G As Byte , Byref B As Byte)
   Local Color_tmp As Dword
   Color_tmp = Color
   Color_tmp = Color_tmp And &H1F
   Color_tmp = Color_tmp * 527
   Color_tmp = Color_tmp + 23
   Shift Color_tmp , Right , 6
   B = Color_tmp
   Shift Color , Right , 5
   Color_tmp = Color
   Color_tmp = Color_tmp And &H3F
   Color_tmp = Color_tmp * 259
   Color_tmp = Color_tmp + 33
   Shift Color_tmp , Right , 6
   G = Color_tmp
   Shift Color , Right , 6
   Color_tmp = Color
   Color_tmp = Color_tmp * 527
   Color_tmp = Color_tmp + 23
   Shift Color_tmp , Right , 6
   R = Color_tmp
End Sub

' Alpha: 32 (Color1) - 0 (Color2)
Function Color16alpha(byval Color1 As Word , Byval Color2 As Word , Byval Alpha As Byte) As Word
   Local Color_tmp1 As Dword , Color_tmp2 As Dword
   Color_tmp1 = Color1
   Shift Color_tmp1 , Left , 16
   Color_tmp1 = Color_tmp1 + Color1
   Color_tmp1 = Color_tmp1 And &H07E0F81F
   Color_tmp2 = Color2
   Shift Color_tmp2 , Left , 16
   Color_tmp2 = Color_tmp2 + Color2
   Color_tmp2 = Color_tmp2 And &H07E0F81F
   Color_tmp1 = Color_tmp1 - Color_tmp2
   Color_tmp1 = Color_tmp1 * Alpha
   Shift Color_tmp1 , Right , 5
   Color_tmp1 = Color_tmp1 + Color_tmp2
   Color_tmp1 = Color_tmp1 And &H07E0F81F
   Color2 = Color_tmp1
   Shift Color_tmp1 , Right , 16
   Color1 = Color_tmp1
   Color2 = Color2 Or Color1
   Color16alpha = Color2
End Function

' Custom colors
'Const Color_custom =(((RED_8bit * 249) + 1014) And &HF800) + (Int(((GREEN_8bit * 253) + 505) / 32) And &H07E0) + Int(((BLUE_8bit * 249) + 1014) / 2048)

' Named colors (see ColorTable.xlsm)
Const Color_crimson = &HD8A7
Const Color_lightpink = &HFDB7
Const Color_lightpink1 = &HFD76
Const Color_lightpink2 = &HED15
Const Color_lightpink3 = &HCC72
Const Color_lightpink4 = &H8AEC
Const Color_pink = &HFDF9
Const Color_pink1 = &HFDB8
Const Color_pink2 = &HED56
Const Color_pink3 = &HCC93
Const Color_pink4 = &H8B0D
Const Color_palevioletred = &HDB92
Const Color_palevioletred1 = &HFC15
Const Color_palevioletred2 = &HEBD3
Const Color_palevioletred3 = &HCB51
Const Color_palevioletred4 = &H8A4B
Const Color_lavenderblush = &HFF7E
Const Color_lavenderblush2 = &HEEFC
Const Color_lavenderblush3 = &HCE18
Const Color_lavenderblush4 = &H8C10
Const Color_violetred1 = &HF9F2
Const Color_violetred2 = &HE9D1
Const Color_violetred3 = &HC98F
Const Color_violetred4 = &H890A
Const Color_hotpink = &HFB56
Const Color_hotpink1 = &HFB76
Const Color_hotpink2 = &HEB54
Const Color_hotpink3 = &HCB12
Const Color_hotpink4 = &H89CC
Const Color_raspberry = &H812B
Const Color_deeppink = &HF8B2
Const Color_deeppink2 = &HE891
Const Color_deeppink3 = &HC88E
Const Color_deeppink4 = &H884A
Const Color_maroon1 = &HF9B6
Const Color_maroon2 = &HE994
Const Color_maroon3 = &HC952
Const Color_maroon4 = &H88EC
Const Color_mediumvioletred = &HC0B0
Const Color_violetred = &HC912
Const Color_orchid = &HDB9A
Const Color_orchid1 = &HFC1E
Const Color_orchid2 = &HEBDC
Const Color_orchid3 = &HCB58
Const Color_orchid4 = &H8A51
Const Color_thistle = &HD5FA
Const Color_thistle1 = &HFF1F
Const Color_thistle2 = &HEE9D
Const Color_thistle3 = &HCDB9
Const Color_thistle4 = &H8BD1
Const Color_plum1 = &HFDDF
Const Color_plum2 = &HED7D
Const Color_plum3 = &HCCB9
Const Color_plum4 = &H8B31
Const Color_plum = &HDD1B
Const Color_violet = &HEC1D
Const Color_magenta = &HF81F
Const Color_magenta2 = &HE81D
Const Color_magenta3 = &HC819
Const Color_darkmagenta = &H8811
Const Color_purple = &H8010
Const Color_mediumorchid = &HBABA
Const Color_mediumorchid1 = &HDB3F
Const Color_mediumorchid2 = &HCAFD
Const Color_mediumorchid3 = &HB299
Const Color_mediumorchid4 = &H79D1
Const Color_darkviolet = &H901A
Const Color_darkorchid = &H9999
Const Color_darkorchid1 = &HB9FF
Const Color_darkorchid2 = &HB1DD
Const Color_darkorchid3 = &H9999
Const Color_darkorchid4 = &H6911
Const Color_indigo = &H4810
Const Color_blueviolet = &H897B
Const Color_purple1 = &H999F
Const Color_purple2 = &H917D
Const Color_purple3 = &H7939
Const Color_purple4 = &H50D1
Const Color_mediumpurple = &H939B
Const Color_mediumpurple1 = &HAC1F
Const Color_mediumpurple2 = &H9BDD
Const Color_mediumpurple3 = &H8B59
Const Color_mediumpurple4 = &H5A51
Const Color_darkslateblue = &H49F1
Const Color_lightslateblue = &H839F
Const Color_mediumslateblue = &H7B5D
Const Color_slateblue = &H6AD9
Const Color_slateblue1 = &H837F
Const Color_slateblue2 = &H7B3D
Const Color_slateblue3 = &H6AD9
Const Color_slateblue4 = &H49F1
Const Color_ghostwhite = &HF7BF
Const Color_lavender = &HE73E
Const Color_blue = &H001F
Const Color_blue2 = &H001D
Const Color_mediumblue = &H0019
Const Color_darkblue = &H0011
Const Color_navy = &H0010
Const Color_midnightblue = &H18CE
Const Color_cobalt = &H3AD5
Const Color_royalblue = &H435B
Const Color_royalblue1 = &H4BBF
Const Color_royalblue2 = &H437D
Const Color_royalblue3 = &H3AF9
Const Color_royalblue4 = &H2A11
Const Color_cornflowerblue = &H64BD
Const Color_lightsteelblue = &HAE1B
Const Color_lightsteelblue1 = &HCF1F
Const Color_lightsteelblue2 = &HBE9D
Const Color_lightsteelblue3 = &HA5B9
Const Color_lightsteelblue4 = &H6BD1
Const Color_lightslategray = &H7453
Const Color_slategray = &H7412
Const Color_slategray1 = &HC71F
Const Color_slategray2 = &HB69D
Const Color_slategray3 = &H9DB9
Const Color_slategray4 = &H6BD1
Const Color_dodgerblue = &H249F
Const Color_dodgerblue2 = &H1C3D
Const Color_dodgerblue3 = &H1BB9
Const Color_dodgerblue4 = &H1271
Const Color_aliceblue = &HEFBF
Const Color_steelblue = &H4C16
Const Color_steelblue1 = &H65BF
Const Color_steelblue2 = &H5D5D
Const Color_steelblue3 = &H54B9
Const Color_steelblue4 = &H3B31
Const Color_lightskyblue = &H867E
Const Color_lightskyblue1 = &HAF1F
Const Color_lightskyblue2 = &HA69D
Const Color_lightskyblue3 = &H8DB9
Const Color_lightskyblue4 = &H63D1
Const Color_skyblue1 = &H867F
Const Color_skyblue2 = &H7DFD
Const Color_skyblue3 = &H6D39
Const Color_skyblue4 = &H4B91
Const Color_skyblue = &H867D
Const Color_deepskyblue = &H05FF
Const Color_deepskyblue2 = &H059D
Const Color_deepskyblue3 = &H04D9
Const Color_deepskyblue4 = &H0351
Const Color_peacock = &H3518
Const Color_lightblue = &HAEBC
Const Color_lightblue1 = &HBF7F
Const Color_lightblue2 = &HB6FD
Const Color_lightblue3 = &H9DF9
Const Color_lightblue4 = &H6C11
Const Color_powderblue = &HAEFC
Const Color_cadetblue1 = &H97BF
Const Color_cadetblue2 = &H8F3D
Const Color_cadetblue3 = &H7E39
Const Color_cadetblue4 = &H5431
Const Color_turquoise1 = &H07BF
Const Color_turquoise2 = &H073D
Const Color_turquoise3 = &H0639
Const Color_turquoise4 = &H0431
Const Color_cadetblue = &H64F3
Const Color_darkturquoise = &H0679
Const Color_azure = &HEFFF
Const Color_azure2 = &HDF7D
Const Color_azure3 = &HBE79
Const Color_azure4 = &H8451
Const Color_lightcyan = &HDFFF
Const Color_lightcyan2 = &HCF7D
Const Color_lightcyan3 = &HB679
Const Color_lightcyan4 = &H7C51
Const Color_paleturquoise1 = &HBFFF
Const Color_paleturquoise = &HAF7D
Const Color_paleturquoise3 = &H9679
Const Color_paleturquoise4 = &H6451
Const Color_darkslategray = &H328A
Const Color_darkslategray1 = &H97FF
Const Color_darkslategray2 = &H8F7D
Const Color_darkslategray3 = &H7E79
Const Color_darkslategray4 = &H5451
Const Color_cyan = &H07FF
Const Color_cyan2 = &H077D
Const Color_cyan3 = &H0679
Const Color_darkcyan = &H0451
Const Color_teal = &H0410
Const Color_mediumturquoise = &H4E99
Const Color_lightseagreen = &H2595
Const Color_manganeseblue = &H0553
Const Color_turquoise = &H46F9
Const Color_coldgrey = &H8450
Const Color_turquoiseblue = &H0631
Const Color_aquamarine = &H7FFA
Const Color_aquamarine2 = &H7778
Const Color_mediumaquamarine = &H6675
Const Color_aquamarine4 = &H444E
Const Color_mediumspringgreen = &H07D3
Const Color_mintcream = &HF7FE
Const Color_springgreen = &H07EF
Const Color_springgreen1 = &H076E
Const Color_springgreen2 = &H066C
Const Color_springgreen3 = &H0448
Const Color_mediumseagreen = &H3D8E
Const Color_seagreen1 = &H57F3
Const Color_seagreen2 = &H4F72
Const Color_seagreen3 = &H4670
Const Color_seagreen = &H344B
Const Color_emeraldgreen = &H064B
Const Color_mint = &HBFD8
Const Color_cobaltgreen = &H3C88
Const Color_honeydew = &HEFFD
Const Color_honeydew2 = &HDF7B
Const Color_honeydew3 = &HBE77
Const Color_honeydew4 = &H8450
Const Color_darkseagreen = &H8DD1
Const Color_darkseagreen1 = &HBFF7
Const Color_darkseagreen2 = &HB776
Const Color_darkseagreen3 = &H9E73
Const Color_darkseagreen4 = &H6C4D
Const Color_palegreen = &H97D2
Const Color_palegreen1 = &H9FF3
Const Color_lightgreen = &H9772
Const Color_palegreen3 = &H7E6F
Const Color_palegreen4 = &H544A
Const Color_limegreen = &H3666
Const Color_forestgreen = &H2444
Const Color_lime = &H07E0
Const Color_green2 = &H0760
Const Color_green3 = &H0660
Const Color_green4 = &H0440
Const Color_green = &H0400
Const Color_darkgreen = &H0320
Const Color_sapgreen = &H3402
Const Color_lawngreen = &H7FC0
Const Color_chartreuse = &H7FE0
Const Color_chartreuse2 = &H7760
Const Color_chartreuse3 = &H6660
Const Color_chartreuse4 = &H4440
Const Color_greenyellow = &HAFE6
Const Color_darkolivegreen1 = &HCFEE
Const Color_darkolivegreen2 = &HBF6D
Const Color_darkolivegreen3 = &HA66B
Const Color_darkolivegreen4 = &H6C47
Const Color_darkolivegreen = &H5346
Const Color_olivedrab = &H6C64
Const Color_olivedrab1 = &HBFE8
Const Color_olivedrab2 = &HB767
Const Color_yellowgreen = &H9E66
Const Color_olivedrab4 = &H6C44
Const Color_ivory = &HFFFD
Const Color_ivory2 = &HEF7B
Const Color_ivory3 = &HCE77
Const Color_ivory4 = &H8C50
Const Color_beige = &HF7BB
Const Color_lightyellow = &HFFFB
Const Color_lightyellow2 = &HEF79
Const Color_lightyellow3 = &HCE76
Const Color_lightyellow4 = &H8C4F
Const Color_lightgoldenrodyellow = &HF7DA
Const Color_yellow = &HFFE0
Const Color_yellow2 = &HEF60
Const Color_yellow3 = &HCE60
Const Color_yellow4 = &H8C40
Const Color_warmgrey = &H840D
Const Color_olive = &H8400
Const Color_darkkhaki = &HBDAD
Const Color_khaki1 = &HFFB1
Const Color_khaki2 = &HEF30
Const Color_khaki3 = &HCE2E
Const Color_khaki4 = &H8C29
Const Color_khaki = &HEF31
Const Color_palegoldenrod = &HEF35
Const Color_lemonchiffon = &HFFD9
Const Color_lemonchiffon2 = &HEF57
Const Color_lemonchiffon3 = &HCE54
Const Color_lemonchiffon4 = &H8C4E
Const Color_lightgoldenrod1 = &HFF51
Const Color_lightgoldenrod2 = &HEED0
Const Color_lightgoldenrod3 = &HCDEE
Const Color_lightgoldenrod4 = &H8C09
Const Color_banana = &HE66B
Const Color_gold = &HFEA0
Const Color_gold2 = &HEE40
Const Color_gold3 = &HCD60
Const Color_gold4 = &H8BA0
Const Color_cornsilk = &HFFBB
Const Color_cornsilk2 = &HEF39
Const Color_cornsilk3 = &HCE36
Const Color_cornsilk4 = &H8C4F
Const Color_goldenrod = &HDD24
Const Color_goldenrod1 = &HFE04
Const Color_goldenrod2 = &HED84
Const Color_goldenrod3 = &HCCC4
Const Color_goldenrod4 = &H8B42
Const Color_darkgoldenrod = &HB421
Const Color_darkgoldenrod1 = &HFDC2
Const Color_darkgoldenrod2 = &HED62
Const Color_darkgoldenrod3 = &HCCA1
Const Color_darkgoldenrod4 = &H8B21
Const Color_orange = &HFD20
Const Color_orange2 = &HECC0
Const Color_orange3 = &HCC20
Const Color_orange5 = &H8AC0
Const Color_floralwhite = &HFFDD
Const Color_oldlace = &HFFBC
Const Color_wheat = &HF6F6
Const Color_wheat1 = &HFF37
Const Color_wheat2 = &HEEB5
Const Color_wheat3 = &HCDD2
Const Color_wheat4 = &H8BEC
Const Color_moccasin = &HFF16
Const Color_papayawhip = &HFF7A
Const Color_blanchedalmond = &HFF59
Const Color_navajowhite = &HFEF5
Const Color_navajowhite2 = &HEE74
Const Color_navajowhite3 = &HCD91
Const Color_navajowhite4 = &H8BCB
Const Color_eggshell = &HFF38
Const Color_tan = &HD591
Const Color_brick = &H9B24
Const Color_cadmiumyellow = &HFCC2
Const Color_antiquewhite = &HF75A
Const Color_antiquewhite1 = &HFF7B
Const Color_antiquewhite2 = &HEEF9
Const Color_antiquewhite3 = &HCDF5
Const Color_antiquewhite4 = &H8C0F
Const Color_burlywood = &HDDB0
Const Color_burlywood1 = &HFE93
Const Color_burlywood2 = &HEE32
Const Color_burlywood3 = &HCD4F
Const Color_burlywood4 = &H8B8A
Const Color_bisque = &HFF18
Const Color_bisque2 = &HEEB6
Const Color_bisque3 = &HCDB3
Const Color_bisque4 = &H8BED
Const Color_melon = &HE54D
Const Color_carrot = &HEC84
Const Color_darkorange = &HFC60
Const Color_darkorange1 = &HFBE0
Const Color_darkorange2 = &HEBA0
Const Color_darkorange3 = &HCB20
Const Color_darkorange4 = &H8A20
Const Color_tan1 = &HFD2A
Const Color_tan2 = &HECC9
Const Color_peru = &HCC28
Const Color_tan4 = &H8AC5
Const Color_linen = &HF77C
Const Color_peachpuff = &HFED6
Const Color_peachpuff2 = &HEE55
Const Color_peachpuff3 = &HCD72
Const Color_peachpuff4 = &H8BAC
Const Color_seashell = &HFFBD
Const Color_seashell2 = &HEF3B
Const Color_seashell3 = &HCE37
Const Color_seashell4 = &H8C30
Const Color_sandybrown = &HF52C
Const Color_rawsienna = &HC302
Const Color_chocolate = &HD344
Const Color_chocolate1 = &HFBE4
Const Color_chocolate2 = &HEBA4
Const Color_chocolate3 = &HCB24
Const Color_saddlebrown = &H8A22
Const Color_ivoryblack = &H2924
Const Color_flesh = &HFBE8
Const Color_cadmiumorange = &HFB00
Const Color_burntsienna = &H89A2
Const Color_sienna = &H9A85
Const Color_sienna1 = &HFC09
Const Color_sienna2 = &HEBC8
Const Color_sienna3 = &HCB47
Const Color_sienna4 = &H8A45
Const Color_lightsalmon = &HFD0F
Const Color_lightsalmon2 = &HECAE
Const Color_lightsalmon3 = &HCC0C
Const Color_lightsalmon4 = &H8AA8
Const Color_coral = &HFBEA
Const Color_orangered = &HFA20
Const Color_orangered2 = &HEA00
Const Color_orangered3 = &HC9C0
Const Color_orangered4 = &H8920
Const Color_sepia = &H5922
Const Color_darksalmon = &HE4AF
Const Color_salmon1 = &HFC6D
Const Color_salmon2 = &HEC0C
Const Color_salmon3 = &HCB8A
Const Color_salmon4 = &H8A67
Const Color_coral1 = &HFB8A
Const Color_coral2 = &HEB4A
Const Color_coral3 = &HCAC8
Const Color_coral4 = &H89E6
Const Color_burntumber = &H89A4
Const Color_tomato = &HFB09
Const Color_tomato2 = &HEAE8
Const Color_tomato3 = &HCA87
Const Color_tomato4 = &H89A5
Const Color_salmon = &HF40E
Const Color_mistyrose = &HFF1B
Const Color_mistyrose2 = &HEEBA
Const Color_mistyrose3 = &HCDB6
Const Color_mistyrose4 = &H8BEF
Const Color_snow = &HFFDE
Const Color_snow2 = &HEF5C
Const Color_snow3 = &HCE58
Const Color_snow4 = &H8C51
Const Color_rosybrown = &HBC71
Const Color_rosybrown1 = &HFE17
Const Color_rosybrown2 = &HED96
Const Color_rosybrown3 = &HCCD3
Const Color_rosybrown4 = &H8B4D
Const Color_lightcoral = &HEC10
Const Color_indianred = &HCAEB
Const Color_indianred1 = &HFB4D
Const Color_indianred2 = &HEB0C
Const Color_indianred3 = &HCAAA
Const Color_indianred4 = &HA8C4
Const Color_indianred5 = &H89C7
Const Color_brown = &HA145
Const Color_brown1 = &HFA08
Const Color_brown2 = &HE9E7
Const Color_brown3 = &HC9A6
Const Color_brown4 = &H8924
Const Color_firebrick = &HB104
Const Color_firebrick1 = &HF986
Const Color_firebrick2 = &HE965
Const Color_firebrick3 = &HC925
Const Color_firebrick4 = &H88C3
Const Color_red = &HF800
Const Color_red2 = &HE800
Const Color_red3 = &HC800
Const Color_darkred = &H8800
Const Color_maroon = &H8000
Const Color_sgibeet = &H89D1
Const Color_sgislateblue = &H7398
Const Color_sgilightblue = &H7CF7
Const Color_sgiteal = &H3C71
Const Color_sgichartreuse = &H762E
Const Color_sgiolivedrab = &H8C67
Const Color_sgibrightgray = &HC615
Const Color_sgisalmon = &HC38E
Const Color_sgidarkgray = &H52AA
Const Color_sgigray12 = &H20E4
Const Color_sgigray16 = &H2945
Const Color_sgigray32 = &H528A
Const Color_sgigray36 = &H5ACB
Const Color_sgigray52 = &H8430
Const Color_sgigray56 = &H8C71
Const Color_sgilightgray = &HAD55
Const Color_sgigray72 = &HB5B6
Const Color_sgigray76 = &HBE17
Const Color_sgigray92 = &HE75C
Const Color_sgigray96 = &HF79E
Const Color_white = &HFFFF
Const Color_whitesmoke = &HF7BE
Const Color_gainsboro = &HDEDB
Const Color_lightgrey = &HD69A
Const Color_silver = &HBDF7
Const Color_darkgray = &HAD55
Const Color_gray = &H8410
Const Color_dimgray = &H6B4D
Const Color_black = &H0000
Const Color_gray99 = &HFFDF
Const Color_gray98 = &HF7DE
Const Color_gray97 = &HF7BE
Const Color_gray96 = &HF7BE
Const Color_gray95 = &HEF9D
Const Color_gray94 = &HEF7D
Const Color_gray93 = &HEF7D
Const Color_gray92 = &HEF5D
Const Color_gray91 = &HE73C
Const Color_gray90 = &HE73C
Const Color_gray89 = &HE71C
Const Color_gray88 = &HDEFB
Const Color_gray87 = &HDEFB
Const Color_gray86 = &HDEDB
Const Color_gray85 = &HD6DA
Const Color_gray84 = &HD6BA
Const Color_gray83 = &HD69A
Const Color_gray82 = &HCE99
Const Color_gray81 = &HCE79
Const Color_gray80 = &HCE59
Const Color_gray79 = &HC658
Const Color_gray78 = &HC638
Const Color_gray77 = &HC618
Const Color_gray76 = &HC618
Const Color_gray75 = &HBDF7
Const Color_gray74 = &HBDF7
Const Color_gray73 = &HBDD7
Const Color_gray72 = &HB5B6
Const Color_gray71 = &HB5B6
Const Color_gray70 = &HB596
Const Color_gray69 = &HAD75
Const Color_gray68 = &HAD75
Const Color_gray67 = &HAD55
Const Color_gray66 = &HA554
Const Color_gray65 = &HA534
Const Color_gray64 = &HA514
Const Color_gray63 = &HA514
Const Color_gray62 = &H9CF3
Const Color_gray61 = &H9CF3
Const Color_gray60 = &H9CD3
Const Color_gray59 = &H94B2
Const Color_gray58 = &H94B2
Const Color_gray57 = &H9492
Const Color_gray56 = &H8C71
Const Color_gray55 = &H8C71
Const Color_gray54 = &H8C51
Const Color_gray53 = &H8430
Const Color_gray52 = &H8430
Const Color_gray51 = &H8410
Const Color_gray50 = &H7BEF
Const Color_gray49 = &H7BEF
Const Color_gray48 = &H7BCF
Const Color_gray47 = &H7BCF
Const Color_gray46 = &H73AE
Const Color_gray45 = &H738E
Const Color_gray44 = &H738E
Const Color_gray43 = &H6B6D
Const Color_gray42 = &H6B4D
Const Color_gray41 = &H6B4D
Const Color_gray40 = &H632C
Const Color_gray39 = &H630C
Const Color_gray38 = &H630C
Const Color_gray37 = &H5AEB
Const Color_gray36 = &H5AEB
Const Color_gray35 = &H5ACB
Const Color_gray34 = &H5AAB
Const Color_gray33 = &H52AA
Const Color_gray32 = &H528A
Const Color_gray31 = &H528A
Const Color_gray30 = &H4A69
Const Color_gray29 = &H4A49
Const Color_gray28 = &H4A49
Const Color_gray27 = &H4228
Const Color_gray26 = &H4208
Const Color_gray25 = &H4208
Const Color_gray24 = &H39E7
Const Color_gray23 = &H39E7
Const Color_gray22 = &H39C7
Const Color_gray21 = &H39A7
Const Color_gray20 = &H31A6
Const Color_gray19 = &H3186
Const Color_gray18 = &H3166
Const Color_gray17 = &H2965
Const Color_gray16 = &H2945
Const Color_gray15 = &H2925
Const Color_gray14 = &H2124
Const Color_gray13 = &H2104
Const Color_gray12 = &H2104
Const Color_gray11 = &H18E3
Const Color_gray10 = &H18C3
Const Color_gray9 = &H18C3
Const Color_gray8 = &H10A2
Const Color_gray7 = &H1082
Const Color_gray6 = &H1082
Const Color_gray5 = &H1062
Const Color_gray4 = &H0841
Const Color_gray3 = &H0841
Const Color_gray2 = &H0821
Const Color_gray1 = &H0020