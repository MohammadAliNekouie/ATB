Dreid_demo_cube:
   Data 8                                                                       ' points
      Data -1! , 1! , -1!
      Data 1! , 1! , -1!
      Data 1! , -1! , -1!
      Data -1! , -1! , -1!
      Data -1! , 1! , 1!
      Data 1! , 1! , 1!
      Data 1! , -1! , 1!
      Data -1! , -1! , 1!
   Data 4                                                                       ' faces
      'Data 4                                                                    ' vertices
      '   Data 1 , 2 , 3 , 4
      Data 4                                                                    ' vertices
         Data 2 , 6 , 7 , 3
      'Data 4                                                                    ' vertices
      '   Data 6 , 5 , 8 , 7
      Data 4                                                                    ' vertices
         Data 5 , 1 , 4 , 8
      Data 4                                                                    ' vertices
         Data 1 , 5 , 6 , 2
      Data 4                                                                    ' vertices
         Data 4 , 3 , 7 , 8