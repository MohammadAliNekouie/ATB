SegoeScript_31pt_b:
   Data 32
   Data 46
   Data 4
   Data 68, 114, 101, 105
   Data 30, 92		' D
   Data 0, 0, 0, 14, 31, 31, 3, 30, 30, 10, 31, 15, 15, 1, 7, 7, 0, 3, 1, 0, 0, 2, 7, 255, 255, 2, 240, 0, 0, 13, 128, 193, 255, 255, 2, 63, 0, 31, 255, 255, 2, 192, 0, 0, 0, 1, 1, 1, 3, 3, 1, 7, 7, 1, 15, 15, 0, 31, 62, 62, 0, 252, 248, 248, 0, 240, 224, 128, 0, 64, 248, 252, 252, 3, 248, 248, 0, 240, 240, 0, 224, 224, 1, 192, 192, 1, 128, 128, 0, 0, 0, 9
   Data 20, 46		' r
   Data 0, 0, 20, 7, 15, 15, 1, 0, 0, 2, 1, 3, 3, 0, 7, 7, 3, 3, 3, 0, 0, 127, 255, 255, 2, 31, 63, 124, 248, 240, 224, 192, 192, 0, 128, 128, 4, 56, 255, 255, 2, 248, 192, 0, 0, 11
   Data 25, 73		' e
   Data 0, 0, 24, 3, 7, 31, 63, 127, 124, 248, 240, 255, 255, 0, 127, 127, 0, 12, 0, 0, 9, 127, 255, 255, 1, 239, 30, 62, 124, 248, 240, 224, 192, 0, 0, 1, 1, 1, 0, 3, 7, 15, 30, 60, 120, 240, 192, 192, 0, 240, 248, 248, 0, 252, 124, 60, 60, 2, 56, 120, 120, 0, 240, 240, 0, 224, 192, 192, 0, 128, 0, 0, 4
   Data 21, 59		' i
   Data 0, 0, 0, 16, 120, 248, 248, 2, 96, 0, 0, 10, 1, 7, 15, 15, 1, 6, 0, 0, 13, 255, 255, 3, 0, 0, 6, 1, 3, 3, 0, 7, 15, 30, 124, 112, 224, 248, 254, 254, 0, 255, 63, 31, 31, 1, 62, 62, 0, 124, 248, 240, 240, 0, 224, 192, 0, 0, 2
