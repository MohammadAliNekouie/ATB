MatrixCodeNFI_12pt:                                                              ' Matrix Code NFI, 12pt
Data 16                                                                          ' Font height in pixels
Data 16                                                                          ' Spacing: 1px
Data 95                                                                          ' Chars: 95
' Charset:  !"#$%&'()*+,-./0123456789:;<=>?@ABCDEFGHIJKLMNOPQRSTUVWXYZ[\]^_`abcdefghijklmnopqrstuvwxyz{|}~
Data 32, 33, 34, 35, 36, 37, 38, 39, 40, 41, 42, 43, 44, 45, 46, 47, 48, 49, 50
Data 51, 52, 53, 54, 55, 56, 57, 58, 59, 60, 61, 62, 63, 64, 65, 66, 67, 68, 69
Data 70, 71, 72, 73, 74, 75, 76, 77, 78, 79, 80, 81, 82, 83, 84, 85, 86, 87, 88
Data 89, 90, 91, 92, 93, 94, 95, 96, 97, 98, 99, 100, 101, 102, 103, 104, 105, 106
Data 107, 108, 109, 110, 111, 112, 113, 114, 115, 116, 117, 118, 119, 120, 121
Data 122, 123, 124, 125, 126
Data 6                                                                           '   6px
Data &H00, &H00, &H00, &H00, &H00, &H00, &H00, &H00, &H00, &H00, &H00, &H00
Data 6                                                                           ' ! 6px
Data &H07, &H3C, &HF3, &H11, &H3F, &H18, &H00, &H0C, &H38, &HE0, &HC0, &H00
Data 7                                                                           ' " 7px
Data &H12, &H32, &H32, &H3F, &H22, &H62, &H02, &H00, &H0C, &H3C, &HF0, &H00
Data &H00, &H00
Data 7                                                                           ' # 7px
Data &H1C, &H06, &H38, &H0C, &H00, &H3F, &H38, &H00, &H0C, &H0C, &H38, &HE0
Data &H80, &H00
Data 7                                                                           ' $ 7px
Data &H02, &H22, &H22, &H23, &H22, &H22, &H02, &H00, &H00, &H1C, &HF8, &H00
Data &H00, &H00
Data 4                                                                           ' % 4px
Data &H7F, &H03, &H01, &H01, &HFC, &H00, &H80, &H80
Data 7                                                                           ' & 7px
Data &H04, &H04, &H04, &H7F, &H04, &H04, &H04, &H00, &H0C, &H38, &HF0, &H00
Data &H00, &H00
Data 7                                                                           ' ' 7px
Data &H00, &H10, &H10, &H10, &H10, &H10, &H00, &H20, &H20, &H20, &H20, &H20
Data &H20, &H20
Data 6                                                                           ' ( 6px
Data &H30, &H32, &H33, &H31, &H3F, &H18, &H0C, &H18, &H70, &HE0, &H70, &H38
Data 7                                                                           ' ) 7px
Data &H10, &H10, &HF1, &HF7, &H1D, &H19, &H00, &H40, &HC0, &HFC, &HFC, &H80
Data &HC0, &H60
Data 5                                                                           ' * 5px
Data &H00, &H00, &H01, &H0F, &H7C, &H18, &H70, &HE0, &H00, &H00
Data 7                                                                           ' + 7px
Data &H00, &H07, &H07, &H00, &H18, &H0F, &H01, &H38, &HF0, &H00, &H00, &H00
Data &H80, &HF0
Data 5                                                                           ' , 5px
Data &H3F, &H06, &H06, &H04, &H0C, &HF8, &H08, &H08, &H08, &H08
Data 6                                                                           ' - 6px
Data &H30, &H30, &H30, &H30, &H3F, &H3E, &H08, &H18, &H30, &H60, &HC0, &H00
Data 7                                                                           ' . 7px
Data &H01, &H07, &H1C, &H1C, &H07, &H01, &H00, &H80, &H00, &H00, &H00, &H00
Data &HC0, &H60
Data 7                                                                           ' / 7px
Data &H08, &H09, &H09, &HFF, &H09, &H09, &H08, &H70, &HE0, &H00, &HFC, &H00
Data &HC0, &H70
Data 7                                                                           ' 0 7px
Data &H0F, &H18, &H11, &H17, &H1E, &H1F, &H03, &HF0, &H78, &HF8, &H88, &H08
Data &HF8, &HC0
Data 4                                                                           ' 1 4px
Data &H0C, &H18, &H1F, &H1F, &H00, &H00, &HF8, &HF8
Data 6                                                                           ' 2 6px
Data &H0F, &H1B, &H11, &H10, &H10, &H18, &H08, &H88, &H88, &HC8, &H78, &H38
Data 6                                                                           ' 3 6px
Data &H10, &H10, &H10, &H10, &H19, &H0F, &H08, &H88, &HC8, &HE8, &HB8, &H18
Data 5                                                                           ' 4 5px
Data &H00, &H03, &H1E, &H18, &H00, &HE0, &HA0, &H20, &H20, &HF8
Data 6                                                                           ' 5 6px
Data &H11, &H13, &H12, &H12, &H1E, &H02, &HE0, &H30, &H18, &H08, &H08, &H08
Data 7                                                                           ' 6 7px
Data &H01, &H07, &H0F, &H1D, &H11, &H10, &H00, &HF0, &H98, &H08, &H08, &H18
Data &HF0, &H60
Data 6                                                                           ' 7 6px
Data &H10, &H10, &H11, &H13, &H1E, &H1C, &H00, &H78, &HF8, &H00, &H00, &H00
Data 7                                                                           ' 8 7px
Data &H0C, &H1E, &H13, &H13, &H1B, &H0E, &H00, &HF0, &HD8, &H88, &H08, &H88
Data &HF0, &H60
Data 7                                                                           ' 9 7px
Data &H0F, &H19, &H10, &H10, &H19, &H0F, &H06, &H80, &HE0, &HF0, &HB8, &H88
Data &H08, &H00
Data 7                                                                           ' : 7px
Data &H18, &H19, &H18, &H18, &H1B, &H1E, &H08, &H00, &H80, &HC0, &HF0, &H98
Data &H00, &H00
Data 5                                                                           ' ; 5px
Data &H62, &H62, &H23, &H31, &H31, &H30, &H30, &H18, &H18, &H8C
Data 7                                                                           ' < 7px
Data &H00, &H00, &H3F, &H78, &H01, &H01, &H00, &H10, &HF0, &HD0, &H30, &HB0
Data &HE0, &H38
Data 5                                                                           ' = 5px
Data &H00, &H0C, &H07, &H0F, &H79, &H18, &H30, &HE0, &H80, &HC0
Data 7                                                                           ' > 7px
Data &H21, &H21, &H3F, &H3F, &H21, &H21, &H01, &H00, &H00, &HF0, &HF8, &H08
Data &H08, &H08
Data 7                                                                           ' ? 7px
Data &H02, &H06, &H7F, &H0F, &H08, &H1B, &H1E, &H00, &H00, &H00, &HFC, &H0C
Data &H80, &H00
Data 14                                                                          ' @ 14px
Data &H03, &H0E, &H18, &H31, &H27, &H4C, &H48, &H48, &H4C, &H4F, &H6E, &H30
Data &H18, &H0F, &HF0, &H1C, &H06, &HF2, &HBB, &H09, &H09, &H11, &H79, &HF9
Data &H0B, &H1A, &H30, &HE0
Data 7                                                                           ' A 7px
Data &H00, &H03, &H0F, &H0E, &H07, &H00, &H00, &H38, &HF0, &H40, &H40, &HC0
Data &H78, &H08
Data 7                                                                           ' B 7px
Data &H0F, &H08, &H08, &H08, &H0D, &H07, &H00, &HF8, &H88, &H88, &H88, &H88
Data &H70, &H20
Data 6                                                                           ' C 6px
Data &H07, &H0E, &H08, &H08, &H0C, &H00, &HF0, &H38, &H08, &H08, &H18, &H10
Data 6                                                                           ' D 6px
Data &H0F, &H08, &H0C, &H06, &H03, &H00, &HF8, &H08, &H08, &H10, &HF0, &H80
Data 6                                                                           ' E 6px
Data &H0F, &H08, &H08, &H08, &H08, &H00, &HF8, &H88, &H88, &H88, &H88, &H08
Data 5                                                                           ' F 5px
Data &H0F, &H08, &H08, &H08, &H08, &HF8, &H80, &H80, &H80, &H00
Data 6                                                                           ' G 6px
Data &H07, &H06, &H08, &H08, &H0C, &H04, &HF0, &H38, &H08, &H88, &H88, &HF8
Data 6                                                                           ' H 6px
Data &H0F, &H00, &H00, &H00, &H0F, &H0F, &HF8, &H80, &H80, &H80, &HF8, &HF8
Data 5                                                                           ' I 5px
Data &H08, &H0F, &H0F, &H08, &H00, &H08, &HF8, &HF8, &H08, &H08
Data 5                                                                           ' J 5px
Data &H00, &H00, &H00, &H0F, &H0F, &H38, &H08, &H08, &HF8, &HE0
Data 7                                                                           ' K 7px
Data &H0F, &H01, &H03, &H06, &H0C, &H08, &H08, &HF8, &HC0, &HC0, &H60, &H30
Data &H18, &H08
Data 6                                                                           ' L 6px
Data &H0F, &H00, &H00, &H00, &H00, &H00, &HF8, &H08, &H08, &H08, &H08, &H08
Data 6                                                                           ' M 6px
Data &H0F, &H0F, &H03, &H03, &H0F, &H0F, &HF8, &H00, &HC0, &HC0, &H00, &HF8
Data 6                                                                           ' N 6px
Data &H0F, &H0F, &H03, &H00, &H00, &H0F, &HF8, &H00, &H80, &HE0, &H78, &HF8
Data 7                                                                           ' O 7px
Data &H07, &H0E, &H08, &H08, &H0C, &H07, &H00, &HF0, &H38, &H08, &H08, &H18
Data &HF0, &H80
Data 6                                                                           ' P 6px
Data &H0F, &H08, &H08, &H08, &H0D, &H07, &HF8, &H80, &H80, &H80, &H80, &H00
Data 7                                                                           ' Q 7px
Data &H07, &H0C, &H08, &H08, &H0E, &H07, &H00, &HE0, &HF0, &H90, &HD0, &H70
Data &HF8, &H08
Data 6                                                                           ' R 6px
Data &H0F, &H08, &H08, &H08, &H0F, &H02, &HF8, &H80, &HC0, &HE0, &HB8, &H08
Data 6                                                                           ' S 6px
Data &H07, &H0D, &H09, &H08, &H0C, &H04, &H30, &H98, &H88, &HC8, &HF8, &H70
Data 6                                                                           ' T 6px
Data &H08, &H08, &H0F, &H0F, &H08, &H08, &H00, &H00, &HF8, &HF8, &H00, &H00
Data 6                                                                           ' U 6px
Data &H0F, &H00, &H00, &H00, &H00, &H0F, &HF0, &H18, &H08, &H08, &H18, &HF0
Data 7                                                                           ' V 7px
Data &H0E, &H07, &H00, &H00, &H01, &H0F, &H0C, &H00, &HC0, &HF8, &H38, &HF8
Data &H80, &H00
Data 7                                                                           ' W 7px
Data &H0F, &H00, &H01, &H01, &H00, &H0F, &H08, &HF0, &H78, &HF0, &HE0, &H78
Data &HF8, &H00
Data 7                                                                           ' X 7px
Data &H08, &H0E, &H03, &H01, &H07, &H0C, &H08, &H08, &H38, &HE0, &HC0, &H70
Data &H18, &H08
Data 7                                                                           ' Y 7px
Data &H08, &H0E, &H03, &H01, &H07, &H0C, &H08, &H00, &H00, &HF8, &HF8, &H00
Data &H00, &H00
Data 5                                                                           ' Z 5px
Data &H08, &H08, &H09, &H0F, &H0C, &H38, &HF8, &HC8, &H08, &H08
Data 6                                                                           ' [ 6px
Data &H24, &H24, &H24, &H24, &H27, &H07, &H00, &H04, &H0C, &H38, &HE0, &H80
Data 5                                                                           ' \ 5px
Data &H21, &H21, &H21, &H21, &H3F, &H10, &H10, &H10, &H10, &HF8
Data 5                                                                           ' ] 5px
Data &H3F, &H00, &H00, &H7F, &H7F, &H80, &H0C, &H1C, &HF0, &HC0
Data 7                                                                           ' ^ 7px
Data &H00, &H08, &H08, &H08, &H0F, &H00, &H00, &H10, &H10, &H10, &H10, &HF0
Data &H10, &H10
Data 7                                                                           ' _ 7px
Data &H02, &H02, &H02, &H02, &H02, &H02, &H02, &H00, &H00, &H00, &H00, &H00
Data &H00, &H00
Data 3                                                                           ' ` 3px
Data &HC0, &HE0, &H20, &H00, &H00, &H00
Data 6                                                                           ' a 6px
Data &H32, &H32, &H32, &H32, &H37, &H3F, &H04, &H0C, &H18, &H30, &HE0, &H00
Data 6                                                                           ' b 6px
Data &H08, &H08, &H0B, &H0B, &H0F, &H04, &H00, &H0C, &HF8, &H80, &H00, &H00
Data 5                                                                           ' c 5px
Data &H00, &H00, &H03, &H0F, &H18, &H60, &HC0, &HFC, &HFC, &H00
Data 5                                                                           ' d 5px
Data &H03, &H02, &H1E, &H02, &H03, &HC0, &H00, &H06, &H1C, &HF0
Data 5                                                                           ' e 5px
Data &H04, &H04, &H07, &H04, &H04, &H10, &H10, &HF0, &H10, &H10
Data 6                                                                           ' f 6px
Data &H02, &H02, &H03, &H1F, &H02, &H02, &H18, &H70, &HE4, &HFC, &H00, &H00
Data 6                                                                           ' g 6px
Data &H01, &H19, &H0F, &H02, &H07, &H07, &H00, &H00, &HE0, &HFC, &H80, &H00
Data 6                                                                           ' h 6px
Data &H02, &H02, &H02, &H03, &H00, &H00, &H10, &H10, &H10, &HF0, &H10, &H10
Data 4                                                                           ' i 4px
Data &H08, &H08, &H08, &H0F, &H88, &H88, &H88, &HFC
Data 5                                                                           ' j 5px
Data &H07, &H09, &H0E, &H00, &H0F, &H00, &H04, &H0C, &H70, &HC0
Data 6                                                                           ' k 6px
Data &H30, &H18, &H00, &H00, &H01, &H07, &H18, &H18, &H30, &H60, &HC0, &H80
Data 7                                                                           ' l 7px
Data &H30, &H30, &H3F, &H3F, &H26, &H3C, &H10, &H00, &H0C, &HF8, &HE0, &H00
Data &H00, &H00
Data 6                                                                           ' m 6px
Data &H00, &H01, &H03, &H0F, &H38, &H20, &HC0, &H80, &H00, &HFC, &H00, &H00
Data 6                                                                           ' n 6px
Data &H0F, &H08, &HF8, &HF8, &H08, &H0F, &H80, &H00, &H0C, &H18, &HF0, &HC0
Data 7                                                                           ' o 7px
Data &H10, &H10, &H10, &H1F, &H10, &H10, &H00, &H10, &H10, &H10, &HF0, &H10
Data &H10, &H10
Data 7                                                                           ' p 7px
Data &H08, &H08, &H09, &HFF, &HFF, &H08, &H08, &H30, &H60, &HC4, &HFC, &HFC
Data &H00, &H00
Data 6                                                                           ' q 6px
Data &H08, &H08, &H7F, &H78, &H08, &H0F, &H0C, &H78, &HE0, &H08, &H38, &HF0
Data 7                                                                           ' r 7px
Data &H08, &H18, &HF8, &H7F, &H11, &H31, &H01, &H80, &H80, &H80, &HFC, &HBC
Data &H00, &H00
Data 6                                                                           ' s 6px
Data &H03, &H1E, &HF0, &H10, &H17, &H1F, &H00, &H0C, &H18, &H70, &HC0, &H00
Data 7                                                                           ' t 7px
Data &H03, &H3E, &H78, &H08, &H0F, &H08, &H08, &H00, &H00, &H0C, &H78, &HC0
Data &H00, &H00
Data 6                                                                           ' u 6px
Data &H08, &H08, &H08, &H08, &H0F, &H0F, &H10, &H10, &H10, &H10, &HF8, &HF8
Data 7                                                                           ' v 7px
Data &H04, &H3F, &H3F, &H04, &H7F, &H7F, &H04, &H00, &H80, &H8C, &H18, &HF0
Data &H80, &H00
Data 7                                                                           ' w 7px
Data &H06, &H63, &H30, &H00, &H00, &H03, &H06, &H00, &H0C, &H18, &H30, &HE0
Data &H80, &H00
Data 7                                                                           ' x 7px
Data &H00, &H30, &H30, &H37, &H3E, &H10, &H00, &H18, &H30, &HE0, &H80, &HC0
Data &H70, &H18
Data 7                                                                           ' y 7px
Data &H02, &H06, &H7F, &H04, &H0C, &H0F, &H0C, &H00, &H00, &HF8, &H08, &HC8
Data &H88, &H00
Data 6                                                                           ' z 6px
Data &H38, &H0E, &H00, &H00, &H0F, &H3E, &H00, &H0C, &H18, &H70, &HC0, &H00
Data 8                                                                           ' { 8px
Data &H00, &H1F, &H1F, &H3F, &H3F, &H00, &H00, &H00, &H1C, &HF8, &HC0, &HF8
Data &HF8, &H30, &HE0, &H80
Data 6                                                                           ' | 6px
Data &H1F, &H10, &H10, &H10, &H1F, &H1F, &HF0, &H20, &H20, &H20, &HF0, &HF0
Data 6                                                                           ' } 6px
Data &H3F, &H00, &H00, &H00, &H01, &H01, &HFC, &H0C, &H18, &H30, &HE0, &H80
Data 6                                                                           ' ~ 6px
Data &H3E, &H20, &H20, &H20, &H3F, &H3F, &H00, &H04, &H0C, &H38, &HE0, &H80
' Program space used: 1379 Bytes