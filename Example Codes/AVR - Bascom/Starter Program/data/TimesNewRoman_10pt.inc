TimesNewRoman_10pt:
   Data 13
   Data 16
   Data 95
   Data 32, 33, 34, 35, 36, 37, 38, 39, 40, 41, 42, 43, 44, 45, 46, 47, 48, 49, 50, 51, 52, 53, 54, 55, 56, 57, 58, 59, 60, 61, 62, 63, 64, 65, 66, 67, 68, 69, 70, 71, 72, 73, 74, 75, 76, 77, 78, 79, 80, 81, 82, 83, 84, 85, 86, 87, 88, 89, 90, 91, 92, 93, 94, 95, 96, 97, 98, 99, 100, 101, 102, 103, 104, 105, 106, 107, 108, 109, 110, 111, 112, 113, 114, 115, 116, 117, 118, 119, 120, 121, 122, 123, 124, 125, 126
   Data 5		'  
   Data 0, 0, 0, 0, 0, 0, 0, 0, 0, 0
   Data 2		' !
   Data 112, 126, 64, 64
   Data 3		' "
   Data 120, 0, 120, 0, 0, 0
   Data 6		' #
   Data 9, 11, 121, 9, 15, 73, 0, 128, 0, 64, 0, 0
   Data 5		' $
   Data 120, 76, 255, 70, 35, 64, 64, 224, 192, 128
   Data 11		' %
   Data 24, 124, 68, 124, 3, 4, 8, 39, 68, 7, 1, 0, 0, 64, 128, 0, 0, 0, 192, 64, 192, 128
   Data 10		' &
   Data 1, 3, 4, 124, 79, 83, 33, 12, 8, 0, 128, 192, 64, 64, 64, 128, 192, 64, 64, 128
   Data 2		' '
   Data 96, 96, 0, 0
   Data 4		' (
   Data 3, 31, 32, 64, 0, 224, 16, 8
   Data 4		' )
   Data 64, 32, 28, 7, 8, 16, 96, 128
   Data 5		' *
   Data 40, 56, 124, 40, 40, 0, 0, 0, 0, 0
   Data 7		' +
   Data 4, 4, 4, 63, 4, 4, 4, 0, 0, 0, 128, 0, 0, 0
   Data 2		' ,
   Data 0, 0, 80, 32
   Data 4		' -
   Data 1, 1, 1, 1, 0, 0, 0, 0
   Data 1		' .
   Data 0, 64
   Data 4		' /
   Data 0, 6, 24, 64, 192, 0, 0, 0
   Data 6		' 0
   Data 14, 63, 64, 64, 96, 31, 0, 128, 64, 64, 192, 0
   Data 3		' 1
   Data 32, 127, 0, 64, 192, 64
   Data 6		' 2
   Data 0, 64, 65, 66, 124, 16, 64, 64, 192, 64, 64, 192
   Data 5		' 3
   Data 0, 96, 68, 76, 55, 64, 64, 64, 64, 128
   Data 6		' 4
   Data 1, 5, 25, 49, 127, 1, 0, 0, 0, 0, 192, 0
   Data 5		' 5
   Data 16, 80, 88, 79, 2, 64, 64, 64, 128, 0
   Data 6		' 6
   Data 6, 31, 60, 104, 76, 71, 0, 128, 64, 64, 192, 128
   Data 5		' 7
   Data 64, 64, 67, 92, 96, 0, 64, 128, 0, 0
   Data 5		' 8
   Data 57, 76, 70, 123, 49, 128, 64, 64, 192, 128
   Data 6		' 9
   Data 24, 62, 66, 66, 99, 62, 0, 64, 64, 128, 0, 0
   Data 2		' :
   Data 8, 8, 64, 64
   Data 2		' ;
   Data 8, 8, 80, 96
   Data 7		' <
   Data 4, 10, 10, 9, 17, 16, 32, 0, 0, 0, 0, 0, 128, 128
   Data 7		' =
   Data 10, 10, 10, 10, 10, 10, 10, 0, 0, 0, 0, 0, 0, 0
   Data 7		' >
   Data 32, 16, 17, 17, 9, 10, 4, 128, 128, 0, 0, 0, 0, 0
   Data 4		' ?
   Data 112, 64, 70, 120, 0, 64, 64, 0
   Data 11		' @
   Data 12, 16, 35, 78, 88, 80, 91, 78, 48, 27, 0, 96, 16, 208, 72, 72, 136, 200, 72, 144, 32, 64
   Data 9		' A
   Data 0, 0, 7, 26, 114, 62, 7, 1, 0, 64, 192, 64, 0, 0, 0, 64, 192, 64
   Data 7		' B
   Data 64, 127, 68, 68, 68, 110, 59, 64, 192, 64, 64, 64, 192, 128
   Data 7		' C
   Data 31, 49, 64, 64, 64, 32, 113, 0, 128, 64, 64, 64, 192, 128
   Data 8		' D
   Data 64, 64, 127, 64, 64, 64, 49, 63, 64, 64, 192, 64, 64, 64, 128, 128
   Data 8		' E
   Data 64, 64, 127, 68, 68, 78, 96, 0, 64, 64, 192, 64, 64, 64, 64, 128
   Data 7		' F
   Data 64, 64, 127, 68, 68, 78, 96, 64, 64, 192, 64, 0, 0, 0
   Data 8		' G
   Data 31, 49, 96, 64, 64, 36, 119, 4, 0, 128, 192, 64, 64, 64, 192, 0
   Data 8		' H
   Data 64, 127, 68, 4, 4, 68, 127, 64, 64, 192, 64, 0, 0, 64, 192, 64
   Data 3		' I
   Data 64, 127, 64, 64, 192, 64
   Data 5		' J
   Data 0, 64, 64, 127, 64, 192, 192, 64, 128, 0
   Data 10		' K
   Data 64, 64, 127, 76, 14, 83, 97, 64, 64, 0, 64, 64, 192, 64, 0, 0, 192, 192, 64, 64
   Data 8		' L
   Data 64, 64, 127, 64, 0, 0, 0, 0, 64, 64, 192, 64, 64, 64, 64, 192
   Data 12		' M
   Data 64, 127, 112, 28, 7, 1, 1, 12, 48, 127, 64, 64, 64, 192, 64, 0, 0, 192, 128, 0, 64, 192, 64, 64
   Data 9		' N
   Data 64, 127, 112, 24, 12, 7, 65, 127, 64, 64, 192, 64, 0, 0, 0, 128, 192, 0
   Data 9		' O
   Data 4, 63, 32, 64, 64, 64, 96, 63, 31, 0, 128, 128, 64, 64, 64, 192, 128, 0
   Data 7		' P
   Data 64, 64, 127, 68, 68, 124, 56, 64, 64, 192, 64, 0, 0, 0
   Data 9		' Q
   Data 6, 63, 32, 64, 64, 64, 96, 63, 31, 0, 128, 192, 64, 96, 96, 240, 144, 16
   Data 9		' R
   Data 64, 64, 127, 68, 70, 121, 56, 0, 0, 64, 64, 192, 64, 0, 128, 192, 64, 64
   Data 6		' S
   Data 57, 76, 68, 38, 115, 1, 192, 64, 64, 64, 192, 0
   Data 7		' T
   Data 96, 64, 64, 127, 64, 64, 96, 0, 64, 64, 192, 64, 0, 0
   Data 9		' U
   Data 64, 64, 127, 64, 0, 0, 64, 127, 64, 0, 0, 128, 192, 64, 64, 192, 128, 0
   Data 9		' V
   Data 64, 96, 120, 79, 3, 1, 6, 112, 64, 0, 0, 0, 0, 192, 128, 0, 0, 0
   Data 12		' W
   Data 64, 112, 124, 7, 65, 102, 124, 71, 1, 70, 120, 64, 0, 0, 0, 128, 192, 0, 0, 0, 192, 0, 0, 0
   Data 9		' X
   Data 64, 64, 97, 91, 12, 14, 83, 96, 64, 64, 192, 192, 0, 0, 64, 192, 192, 64
   Data 9		' Y
   Data 64, 96, 112, 92, 7, 4, 80, 96, 64, 0, 0, 0, 64, 192, 64, 64, 0, 0
   Data 8		' Z
   Data 0, 112, 67, 70, 92, 112, 96, 65, 64, 192, 64, 64, 64, 64, 192, 0
   Data 3		' [
   Data 127, 64, 64, 248, 8, 8
   Data 3		' \
   Data 96, 12, 1, 0, 0, 128
   Data 3		' ]
   Data 64, 64, 127, 8, 8, 248
   Data 6		' ^
   Data 4, 24, 96, 64, 48, 4, 0, 0, 0, 0, 0, 0
   Data 7		' _
   Data 0, 0, 0, 0, 0, 0, 0, 8, 8, 8, 8, 8, 8, 8
   Data 2		' `
   Data 64, 32, 0, 0
   Data 5		' a
   Data 12, 9, 9, 15, 0, 192, 64, 64, 192, 64
   Data 6		' b
   Data 64, 127, 12, 8, 12, 7, 0, 192, 64, 64, 192, 128
   Data 4		' c
   Data 7, 8, 8, 12, 128, 64, 64, 64
   Data 6		' d
   Data 7, 12, 8, 72, 127, 0, 128, 192, 64, 64, 192, 64
   Data 4		' e
   Data 7, 10, 10, 14, 128, 64, 64, 64
   Data 5		' f
   Data 8, 63, 72, 72, 96, 64, 192, 64, 0, 0
   Data 6		' g
   Data 0, 14, 9, 9, 15, 8, 16, 248, 72, 72, 72, 112
   Data 7		' h
   Data 64, 127, 4, 8, 8, 15, 0, 64, 192, 64, 0, 64, 192, 64
   Data 3		' i
   Data 8, 79, 0, 64, 192, 64
   Data 3		' j
   Data 0, 8, 79, 8, 8, 240
   Data 7		' k
   Data 64, 127, 2, 3, 8, 8, 0, 64, 192, 64, 0, 192, 64, 64
   Data 3		' l
   Data 64, 127, 0, 64, 192, 64
   Data 11		' m
   Data 8, 15, 4, 8, 8, 15, 4, 8, 8, 15, 0, 64, 192, 64, 0, 64, 192, 64, 0, 64, 192, 64
   Data 7		' n
   Data 8, 15, 4, 8, 8, 15, 0, 64, 192, 64, 0, 64, 192, 64
   Data 5		' o
   Data 7, 8, 8, 12, 7, 128, 192, 64, 64, 128
   Data 6		' p
   Data 8, 15, 12, 8, 12, 7, 8, 248, 72, 64, 192, 128
   Data 6		' q
   Data 7, 12, 8, 8, 15, 0, 128, 192, 64, 72, 248, 8
   Data 4		' r
   Data 8, 15, 12, 8, 64, 192, 64, 0
   Data 4		' s
   Data 14, 11, 13, 0, 192, 64, 64, 128
   Data 4		' t
   Data 8, 63, 8, 0, 0, 192, 64, 64
   Data 7		' u
   Data 8, 15, 0, 0, 8, 15, 0, 0, 192, 64, 64, 64, 192, 64
   Data 6		' v
   Data 8, 14, 11, 0, 9, 12, 0, 0, 128, 192, 0, 0
   Data 9		' w
   Data 8, 14, 11, 8, 14, 11, 0, 11, 12, 0, 0, 128, 128, 0, 0, 192, 0, 0
   Data 6		' x
   Data 8, 12, 15, 3, 13, 8, 64, 192, 0, 0, 192, 64
   Data 6		' y
   Data 8, 14, 11, 0, 9, 12, 8, 8, 152, 224, 0, 0
   Data 6		' z
   Data 0, 8, 9, 14, 12, 8, 64, 192, 64, 64, 64, 192
   Data 3		' {
   Data 2, 61, 64, 0, 240, 8
   Data 1		' |
   Data 127, 248
   Data 4		' }
   Data 64, 104, 61, 2, 8, 216, 240, 0
   Data 7		' ~
   Data 1, 2, 2, 3, 1, 1, 3, 0, 0, 0, 0, 0, 0, 0
